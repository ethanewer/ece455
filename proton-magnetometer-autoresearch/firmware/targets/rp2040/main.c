/*
 * C4: RP2040 emulator plumbing check (rp2040js, MIT, no quota).
 *
 * Minimal SRAM-resident firmware: no boot2, no vendor SDK. The emulator
 * loads the image into SRAM and starts the core at the vector table
 * (sim/rp2040js/run_fid_est.js sets SP/PC directly), so there is no flash
 * XIP setup to emulate. The firmware:
 *
 *   1. pushes the FID record (generated by tools/export_fid_vector.py
 *      from fid.generate_record at a pinned seed) through the SAME
 *      estimator core the CI sensitivity job runs (freq_est.c);
 *   2. prints "FID-EST-START", then "FREQ_HZ=<integer mHz>" over UART0
 *      (rp2040js mirrors UART0 writes to the console);
 *   3. the runner asserts the reported frequency against the truth.
 *
 * Explicitly NOT a timing/sensitivity oracle (MCU research doc): the
 * emulator is functional, not cycle-accurate. This proves samples move
 * through the firmware estimator, nothing about jitter or clocks.
 */
#include <stdint.h>
#include "freq_est.h"
#include "fid_vector.h"

#define UART0_DR   (*(volatile uint32_t *)0x40034000u)
#define UART0_FR   (*(volatile uint32_t *)0x40034018u)

/* freestanding: libm's math_err needs an errno cell (no libc linked). */
int *__errno(void)
{
    static int _e;
    return &_e;
}

static void uart_putc(char c)
{
    /* Poll TXFF (bit 5) like real hardware; the emulator's FIFO drains
     * instantly so this is a no-op wait there. */
    while (UART0_FR & (1u << 5)) {
    }
    UART0_DR = (uint32_t)(uint8_t)c;
}

static void uart_puts(const char *s)
{
    while (*s) {
        uart_putc(*s++);
    }
}

static void uart_puti(long v)
{
    char buf[12];
    int i = 11;
    buf[i] = '\0';
    if (v == 0) {
        buf[--i] = '0';
    }
    while (v > 0 && i > 0) {
        buf[--i] = (char)('0' + (v % 10));
        v /= 10;
    }
    uart_puts(&buf[i]);
}

/* Vector table: initial SP and Reset handler, relocated to the start of
 * the image (the runner reads SP/PC from here). */
void firmware_main(void);

__attribute__((section(".vectors"), used))
static const void *vectors[2] = {
    (void *)0x20040000,          /* SP: inside the 264 KB SRAM block */
    (void *)&firmware_main,      /* reset entry */
};

void firmware_main(void)
{
    uart_puts("FID-EST-START\n");
    double out_hz = 0.0;
    int rc = freq_est_f32(fid_record, FID_N, FID_FS, FID_T0,
                          500.0, 3500.0, &out_hz);
    uart_puts("RC=");
    uart_puti(rc);
    uart_puts("\n");
    /* Report frequency as integer milli-Hz (integer UART, no printf). */
    long mh = (long)(out_hz * 1000.0);
    uart_puts("FREQ_MHZ=");   /* milli-Hz */
    uart_puti(mh);
    uart_puts("\nFID-EST-DONE\n");
    for (;;) {
        __asm__ volatile("wfi");
    }
}
